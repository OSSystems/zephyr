## lib/updatehub/Kconfig
```kconfig
#
# Copyright (c) 2018 O.S.Systems
#
# SPDX -License-Identifier: Apache-2.0
#

menu "UpdateHub Firmware Over-the-Air configuration"

config UPDATEHUB
	bool"UpdateHub Firmware Over-the-Air support"
	select FLASH
	select REBOOT
	select IMG_MANAGER
	select BOOTLOADER_MCUBOOT
	select MPU_ALLOW_FLASH_WRITE
	select NETWORKING
	select NEWLIB_LIBC
	select NET_UDP
	select NET_SOCKETS
	select NET_SOCKETS_POSIX_NAMES
	select COAP
	select NET_CONFIG_NEED_IPV4
	select NET_CONFIG_SETTINGS
	select DNS_RESOLVER
	select JSON_LIBRARY
	select TINYCRYPT
	select TINYCRYPT_SHA256
	select HWINFO
	default "n"
	help
		UpdateHub is an enterprise-grade solution which makes simple to
		remotely update all your Linux-based devices in the field. It
		handles all aspects related to sending Firmware Over-the-Air
		(FOTA) updates with maximum security and efficiency, while you
		focus in adding value to your product.

if UPDATEHUB

config UPDATEHUB_POLL_INTERVAL
	int "Time to poll interval (in minutes)"
	default 1440
	range 0 43200
	depends on UPDATEHUB
	help
		Set the interval that the UpdateHub update server will be polled.
		This time interval is zero and 43200 minutes(30 days).

config UPDATEHUB_PRODUCT_UID
	string "Product Unique Identifier (UID)"
	default ""
	depends on UPDATEHUB
	help
		The product unique identifier is used when communicating
		with the UpdateHub server.

config UPDATEHUB_CE_SERVER
	bool "Use UpdateHub Community Sever"
	depends on UPDATEHUB
	default "n"
	help
		Allow the use of UpdateHub Community
		Server (updatehub-ce-server) as alternative to the
		updatehub.io enterprise server.

if UPDATEHUB_CE_SERVER

config UPDATEHUB_SERVER
	string "User address for the updatehub-ce-server"
	default ""
	depends on UPDATEHUB_CE_SERVER
	help
		This configuration is default, if need to use
		other address, must be set on the UpdateHub shell
endif #UPDATEHUB_CE_SERVER

config UPDATEHUB_LOG
	bool "Enable Logger"
	depends on UPDATEHUB
	select LOG
	default "n"
	help
		UpdateHub switch for the logger, when turned off log calls will not be
		compiled in.

if UPDATEHUB_LOG

config UPDATEHUB_LOG_LEVEL
	int
	prompt "Updatehub Logging level"
	depends on LOG
	default 1
	range 0 4
	help
		Sets log level for UpdateHub.
		Levels are:
		0 OFF, do not write
		1 ERROR, only write LOG_ERR
		2 WARNING, write LOG_WRN in addition to previous level
		3 INFO, write LOG_INF in addition to previous levels
		4 DEBUG, write LOG_DBG in addition to previous levels
endif #UPDATEHUB_LOG

config UPDATEHUB_SHELL
	bool "Enable updatehub shell utilities"
	depends on UPDATEHUB
	default "n"
	select SHELL
	select KERNEL_SHELL
	help
		Activate shell module that provides UpdateHub commands like
endif #UPDATEHUB

endmenu
```

## subsys/updatehub/Kconfig
```kconfig
#
# Copyright (c) 2018 O.S.Systems
#
# SPDX -License-Identifier: Apache-2.0
#

menu "UpdateHub Firmware Over-the-Air library configuration"

module = UpdateHub
module-str = UpdateHub

config UPDATEHUB
    bool"UpdateHub Firmware Over-the-Air library support"
    select FLASH
    select REBOOT
    select IMG_MANAGER
    select BOOTLOADER_MCUBOOT
    select MPU_ALLOW_FLASH_WRITE
    select NETWORKING
    select NET_UDP
    select COAP
    select NET_CONFIG_CLIENT
    select NET_CONFIG_NEED_IPV4
    select NET_CONFIG_SETTINGS
    select DNS_RESOLVER
    select JSON_LIBRARY
    select TINYCRYPT
    select TINYCRYPT_SHA256
    default "n"
    help
        The options below ought to show only if UpdateHub support is enabled.

if UPDATEHUB
config UPDATEHUB_POLL_INTERVAL
    int "Time to poll interval (in minutes)"
    default 1440
    range 0 43200
    depends on UPDATEHUB
    help
        Set the interval that the UpdateHub update server will be polled.
        This time interval is zero and 43200 minutes(30 days).

config UPDATEHUB_PRODUCT_UID
    string "Set the product's identification"
    default ""
    depends on UPDATEHUB
    help
        Set the board 's product uid

config UPDATEHUB_LOG
    bool "Using to active system log"
    select LOG
    default "y"
    help
        Set log for UpdateHub.

if UPDATEHUB_LOG
config UPDATEHUB_LOG_LEVEL
	int
	prompt "Updatehub Logging level"
	depends on LOG
	default 1
	range 0 4
	help
	  Sets log level for UpdateHub.
	  Levels are:
	  0 OFF, do not write
	  1 ERROR, only write LOG_ERR
	  2 WARNING, write LOG_WRN in addition to previous level
	  3 INFO, write LOG_INF in addition to previous levels
	  4 DEBUG, write LOG_DBG in addition to previous levels

endif #UPDATEHUB_LOG
endif #UPDATEHUB

endmenu
```
