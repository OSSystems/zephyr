## CMakeLists.txt
```
# Copyright (c) 2018 O.S.Systems
#
# SPDX-License-Identifier: Apache-2.0

cmake_minimum_required(VERSION 3.13.1)

# This application has its own Kconfig options.
set(KCONFIG_ROOT ${CMAKE_CURRENT_SOURCE_DIR}/Kconfig)

include($ENV{ZEPHYR_BASE}/cmake/app/boilerplate.cmake NO_POLICY_SCOPE)
project(NONE)

target_sources(app PRIVATE src/main.c)

foreach(inc_file
        servercert.der
        privkey.der
        )
    generate_inc_file_for_target(
        ${ZEPHYR_CURRENT_LIBRARY}
        src/certificates/${inc_file}
        ${gen_dir}/${inc_file}.inc
        )
endforeach()
```

## Kconfig
```
#
#  Copyright (c) 2018 O.S.Systems
#
#  SPDX-License-Identifier: Apache-2.0
#
mainmenu "Sample app Configuration"

config ZEPHYR_BASE
	string
	option env="ZEPHYR_BASE"

config UPDATEHUB_MANUAL
	bool "UpdateHub manual mode"
	default n
	help
		Manual mode requires the user to call the server probe and then, if
		there is an available update, also requires the user to decide if
		it is appropriate to update now or later.

if !UPDATEHUB_MANUAL
config UPDATEHUB_POLLING
	bool "UpdateHub polling mode"
	default y
	help
		Polling mode runs automatically on a predefined period, probing the
		server for updates and installing them without requiring user
		intervention.
endif #!UPDATEHUB_MANUAL

source "$ZEPHYR_BASE/Kconfig.zephyr"
```

## prj.conf
```kconfig
# Turn on the updatehub
CONFIG_UPDATEHUB=y

#Minimal Heap mem pool size for the updatehub working
CONFIG_HEAP_MEM_POOL_SIZE=2048
CONFIG_SYSTEM_WORKQUEUE_STACK_SIZE=2048

CONFIG_UPDATEHUB_DTLS=y
#Minimal TLS configuration
CONFIG_MAIN_STACK_SIZE=3000
CONFIG_NET_BUF_RX_COUNT=50
CONFIG_MBEDTLS_HEAP_SIZE=60000
# End tls configs

CONFIG_NET_DHCPV4=y

#Optional if you would like test on the your server
CONFIG_SHELL=y
CONFIG_UPDATEHUB_SHELL=y

# Debug helpers
CONFIG_LOG=y
CONFIG_UPDATEHUB_LOG_LEVEL_INF=y
```

## overlay-dtls.conf
```kconfig
#
# Copyright (c) 2019 O.S.Systems
#
# SPDX-License-Identifier: Apache-2.0
#

CONFIG_UPDATEHUB_DTLS=y

#Minimal TLS configuration
CONFIG_MAIN_STACK_SIZE=3000
CONFIG_NET_BUF_RX_COUNT=50
CONFIG_MBEDTLS_HEAP_SIZE=60000
```

## src/main.c
```c
/*
 * Copyright (c) 2018 O.S.Systems
 *
 * SPDX-License-Identifier: Apache-2.0
 */

#include <zephyr.h>
#include <updatehub.h>
#include <dfu/mcuboot.h>
#include <misc/printk.h>
#include <logging/log.h>

LOG_MODULE_REGISTER(main);

int main(void)
{
	int ret = 0;

	#if defined(CONFIG_UPDATEHUB_POLLING)
	LOG_INF("Init sample app UpdateHub Polling");
	updatehub_autohandler();
	#endif


	k_sleep(3000);

	/* The image of application needed be confirmed */
	ret = boot_write_img_confirmed();
	if (ret < 0) {
		LOG_ERR("Error to confirm the image");
	}

	#if defined(CONFIG_UPDATEHUB_MANUAL)
	LOG_INF("Init sample app UpdateHub Manual");

	enum updatehub_response resp;

	resp = updatehub_probe();
	if (resp != UPDATEHUB_HAS_UPDATE) {
		if (resp == UPDATEHUB_NO_UPDATE) {
			LOG_INF("No update");
			return -1;
		}
		LOG_ERR("Error at probe");
		return -1;
	} else   {
		resp = updatehub_update();
		if (resp != UPDATEHUB_OK) {
			LOG_ERR("Error to install");
			return -1;
		}
	}
	#endif

	return 0;
}
```
