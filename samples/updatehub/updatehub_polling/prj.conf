## Kconfig
```
#
#  Copyright (c) 2018 O.S.Systems
#
#  SPDX-License-Identifier: Apache-2.0
#
mainmenu "Sample polling app Configuration"

config ZEPHYR_BASE
	string
	option env="ZEPHYR_BASE"

source "$ZEPHYR_BASE/Kconfig.zephyr"
```

## prj.conf
```kconfig
# Turn on the updatehub
CONFIG_UPDATEHUB=y

#Example of product_uid, you must set you product uid.
CONFIG_UPDATEHUB_PRODUCT_UID="e4d37cfe6ec48a2d069cc0bbb8b078677e9a0d8df3a027c4d8ea131130c4265f"

#example for the updatehub will poll on the server request for updates (min: 1 minute, máx: 30 days)
CONFIG_UPDATEHUB_POLL_INTERVAL=1

#Minimal Heap mem pool size for the updatehub working
CONFIG_HEAP_MEM_POOL_SIZE=2048
CONFIG_NET_DHCPV4=y

#Optional if you would like test on the your server
CONFIG_UPDATEHUB_SHELL=y

# Debug helpers
CONFIG_UPDATEHUB_LOG=y
CONFIG_UPDATEHUB_LOG_LEVEL=3

CONFIG_FLASH_PAGE_LAYOUT=y
CONFIG_FLASH_MAP=y
CONFIG_FCB=y
CONFIG_SETTINGS=y
CONFIG_SETTINGS_FCB=y
```

## src/main.c
```c
/*
 * Copyright (c) 2018 O.S.Systems
 *
 * SPDX-License-Identifier: Apache-2.0
 */

#include <zephyr.h>
#include <updatehub.h>
#include <dfu/mcuboot.h>
#include <misc/printk.h>
#include <logging/log.h>

LOG_MODULE_REGISTER(main);

int main(void)
{
	int ret = 0;

	LOG_INF("Init sample app UpdateHub polling");

	ret = updatehub_init_settings();
	if (ret < 0)
	{
		LOG_ERR("Error to settings");
	}

	updatehub_autohandler();

	k_sleep(3000);

	/* The image of application needed be confirmed */
	ret = boot_write_img_confirmed();
	if (ret < 0)
	{
		LOG_ERR("Error to confirm the image");
	}

	return 0;
}
```
