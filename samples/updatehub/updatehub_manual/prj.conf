## Kconfig
```
#
#  Copyright (c) 2018 O.S.Systems
#
#  SPDX-License-Identifier: Apache-2.0
#
mainmenu "Sample manual app Configuration"

config ZEPHYR_BASE
	string
	option env="ZEPHYR_BASE"

source "$ZEPHYR_BASE/Kconfig.zephyr"
```

## prj.conf
```kconfig
# Turn on the updatehub
CONFIG_UPDATEHUB=y

#Example of product_uid, you must set you product uid.
CONFIG_UPDATEHUB_PRODUCT_UID="e4d37cfe6ec48a2d069cc0bbb8b078677e9a0d8df3a027c4d8ea131130c4265f"

#Minimal Heap mem pool size for the updatehub working
CONFIG_HEAP_MEM_POOL_SIZE=2048
CONFIG_NET_DHCPV4=y

#Optional if you would like test on the your server
CONFIG_UPDATEHUB_SHELL=y

# Debug helpers
CONFIG_UPDATEHUB_LOG=y
CONFIG_UPDATEHUB_LOG_LEVEL=3
```

## src/main.c
```c
/*
 * Copyright (c) 2018 O.S.Systems
 *
 * SPDX-License-Identifier: Apache-2.0
 */

#include <zephyr.h>
#include <updatehub.h>
#include <dfu/mcuboot.h>
#include <logging/log.h>

LOG_MODULE_REGISTER(main);

int main(void)
{
	int ret = 0;
	enum updatehub_response resp;

	LOG_INF("Init sample app UpdateHub manual");

	ret = boot_write_img_confirmed();/* The image of application needed be confirmed */
	if (ret < 0)
	{
		LOG_ERR("Error to confirm the image");
	}

	resp = updatehub_probe();
	if (resp != UPDATEHUB_HAS_UPDATE)
	{
		if (resp == UPDATEHUB_NO_UPDATE)
		{
			LOG_INF("No update");
			return -1;
		}
		LOG_ERR("Error at probe");
		return -1;
	}
	else
	{
		resp = updatehub_update();
		if (resp != UPDATEHUB_OK)
		{
			LOG_ERR("Error to install");
			return -1;
		}
	}

	return 0;
}
```
